## configfiles/driver/dsa/Kconfig
```kconfig
config NET_DSA_YT921X
	tristate "Motorcomm YT9215 ethernet switch chip support"
	select NET_DSA_TAG_YT921X
	default n
	help
	  This enables support for the Motorcomm YT9215 ethernet switch chip.

config NET_DSA_YT921X_DEBUG
	bool "Motorcomm YT9215 debug command interface"
	depends on NET_DSA_YT921X
	default n
	help
	  Enable debug command interface under debugfs for yt921x.

config NET_DSA_YT921X_CR881X
	bool "Motorcomm YT921x CR881x conduit isolation policy"
	depends on NET_DSA_YT921X
	default n
	help
	  Enable CR881x-specific secondary conduit user-port isolation policy.
```
